## os/Config.in
```kconfig
menu "MakerOS"

source "$BR2_EXTERNAL_MAKEROS_PATH/package/makerd/Config.in"
source "$BR2_EXTERNAL_MAKEROS_PATH/package/makeros-shell/Config.in"
source "$BR2_EXTERNAL_MAKEROS_PATH/package/makeros-firstboot/Config.in"
source "$BR2_EXTERNAL_MAKEROS_PATH/package/uv-bin/Config.in"
source "$BR2_EXTERNAL_MAKEROS_PATH/package/llama-cpp/Config.in"
source "$BR2_EXTERNAL_MAKEROS_PATH/package/makeros-node/Config.in"
source "$BR2_EXTERNAL_MAKEROS_PATH/package/font-inter/Config.in"
source "$BR2_EXTERNAL_MAKEROS_PATH/package/labwc/Config.in"
source "$BR2_EXTERNAL_MAKEROS_PATH/package/chromium-bin/Config.in"

endmenu
```

## os/configs/makeros_rpi4_defconfig
```kconfig
# MakerOS 2 - Raspberry Pi 4 / 400 (aarch64, 4 GB)
# Buildroot 2026.02.3 + BR2_EXTERNAL MAKEROS

# --- Mimari ---------------------------------------------------------------------
BR2_aarch64=y
BR2_cortex_a72=y
BR2_ARM_FPU_VFPV4=y

# --- Derleme --------------------------------------------------------------------
BR2_CCACHE=y
BR2_GLOBAL_PATCH_DIR="$(BR2_EXTERNAL_MAKEROS_PATH)/patches"
BR2_DOWNLOAD_FORCE_CHECK_HASHES=y
BR2_OPTIMIZE_2=y

# --- Toolchain ------------------------------------------------------------------
# Bootlin hazir toolchain'leri yalnizca x86_64 host icin var (Config.in:
# depends on BR2_HOSTARCH = "x86_64"); arm64 Docker'da Buildroot'un kendi
# glibc toolchain'i derlenir (gcc 14, glibc 2.42, headers 6.18).
BR2_TOOLCHAIN_BUILDROOT_GLIBC=y
BR2_KERNEL_HEADERS_6_18=y
BR2_TOOLCHAIN_BUILDROOT_CXX=y

# --- Sistem ---------------------------------------------------------------------
BR2_TARGET_GENERIC_HOSTNAME="makeros"
BR2_TARGET_GENERIC_ISSUE="MakerOS"
BR2_INIT_SYSTEMD=y
BR2_INIT_SYSTEMD_VAR_NONE=y
# BR2_TARGET_GENERIC_REMOUNT_ROOTFS_RW is not set
BR2_SYSTEM_BIN_SH_BASH=y
# BR2_TARGET_GENERIC_GETTY is not set
BR2_ROOTFS_USERS_TABLES="$(BR2_EXTERNAL_MAKEROS_PATH)/board/rpi4/users.txt"
BR2_ROOTFS_OVERLAY="$(BR2_EXTERNAL_MAKEROS_PATH)/board/rpi4/rootfs-overlay"
BR2_ROOTFS_POST_BUILD_SCRIPT="$(BR2_EXTERNAL_MAKEROS_PATH)/board/rpi4/post-build.sh"
BR2_ROOTFS_POST_IMAGE_SCRIPT="$(BR2_EXTERNAL_MAKEROS_PATH)/board/rpi4/post-image.sh"
BR2_ENABLE_LOCALE_WHITELIST="C en_US tr_TR"
BR2_GENERATE_LOCALE="en_US.UTF-8 tr_TR.UTF-8"
BR2_TARGET_TZ_INFO=y
BR2_TARGET_LOCALTIME="Europe/Istanbul"

# --- Cekirdek: raspberrypi/linux rpi-6.18.y (6.18.59), sabit commit ------------
BR2_LINUX_KERNEL=y
BR2_LINUX_KERNEL_CUSTOM_TARBALL=y
BR2_LINUX_KERNEL_CUSTOM_TARBALL_LOCATION="$(call github,raspberrypi,linux,b3495ea401d709af0701a85babcba5e3d788a602)/linux-b3495ea401d709af0701a85babcba5e3d788a602.tar.gz"
BR2_LINUX_KERNEL_DEFCONFIG="bcm2711"
BR2_LINUX_KERNEL_CONFIG_FRAGMENT_FILES="$(BR2_EXTERNAL_MAKEROS_PATH)/board/rpi4/linux.fragment"
BR2_LINUX_KERNEL_DTS_SUPPORT=y
BR2_LINUX_KERNEL_INTREE_DTS_NAME="broadcom/bcm2711-rpi-4-b broadcom/bcm2711-rpi-400 broadcom/bcm2711-rpi-cm4"
BR2_LINUX_KERNEL_NEEDS_HOST_OPENSSL=y

# --- Pi firmware ----------------------------------------------------------------
BR2_PACKAGE_RPI_FIRMWARE=y
BR2_PACKAGE_RPI_FIRMWARE_VARIANT_PI4=y
BR2_PACKAGE_RPI_FIRMWARE_CONFIG_FILE="$(BR2_EXTERNAL_MAKEROS_PATH)/board/rpi4/config.txt"
# BR2_PACKAGE_RPI_FIRMWARE_INSTALL_DTBS is not set
BR2_PACKAGE_RPI_FIRMWARE_INSTALL_DTB_OVERLAYS=y
BR2_PACKAGE_BRCMFMAC_SDIO_FIRMWARE_RPI=y
BR2_PACKAGE_BRCMFMAC_SDIO_FIRMWARE_RPI_BT=y
BR2_PACKAGE_BRCMFMAC_SDIO_FIRMWARE_RPI_WIFI=y
BR2_PACKAGE_WIRELESS_REGDB=y

# --- systemd --------------------------------------------------------------------
BR2_PACKAGE_SYSTEMD_ANALYZE=y
BR2_PACKAGE_SYSTEMD_HOSTNAMED=y
BR2_PACKAGE_SYSTEMD_HWDB=y
BR2_PACKAGE_SYSTEMD_LOCALED=y
BR2_PACKAGE_SYSTEMD_LOGIND=y
BR2_PACKAGE_SYSTEMD_MYHOSTNAME=y
# BR2_PACKAGE_SYSTEMD_NETWORKD is not set
BR2_PACKAGE_SYSTEMD_OOMD=y
BR2_PACKAGE_SYSTEMD_POLKIT=y
BR2_PACKAGE_SYSTEMD_RANDOMSEED=y
BR2_PACKAGE_SYSTEMD_REPART=y
BR2_PACKAGE_SYSTEMD_RESOLVED=y
BR2_PACKAGE_SYSTEMD_RFKILL=y
BR2_PACKAGE_SYSTEMD_SYSEXT=y
BR2_PACKAGE_SYSTEMD_TIMEDATED=y
BR2_PACKAGE_SYSTEMD_TIMESYNCD=y
BR2_PACKAGE_SYSTEMD_VCONSOLE=y
BR2_PACKAGE_LINUX_PAM=y
BR2_PACKAGE_POLKIT=y
BR2_PACKAGE_DBUS_BROKER=y

# --- Temel araclar --------------------------------------------------------------
BR2_PACKAGE_BASH=y
BR2_PACKAGE_COREUTILS=y
BR2_PACKAGE_FINDUTILS=y
BR2_PACKAGE_GREP=y
BR2_PACKAGE_SED=y
BR2_PACKAGE_GAWK=y
BR2_PACKAGE_LESS=y
BR2_PACKAGE_PROCPS_NG=y
BR2_PACKAGE_TAR=y
BR2_PACKAGE_GZIP=y
BR2_PACKAGE_XZ=y
BR2_PACKAGE_ZSTD=y
BR2_PACKAGE_UNZIP=y
BR2_PACKAGE_FILE=y
BR2_PACKAGE_NANO=y
BR2_PACKAGE_HTOP=y
BR2_PACKAGE_TMUX=y
BR2_PACKAGE_JQ=y
BR2_PACKAGE_SUDO=y
BR2_PACKAGE_KMOD_TOOLS=y
BR2_PACKAGE_UTIL_LINUX_BINARIES=y
BR2_PACKAGE_UTIL_LINUX_PARTX=y
BR2_PACKAGE_UTIL_LINUX_MOUNTPOINT=y
BR2_PACKAGE_UTIL_LINUX_NOLOGIN=y
BR2_PACKAGE_UTIL_LINUX_ZRAMCTL=y
BR2_PACKAGE_UTIL_LINUX_SETPRIV=y
BR2_PACKAGE_UTIL_LINUX_NSENTER=y
BR2_PACKAGE_UTIL_LINUX_UNSHARE=y
BR2_PACKAGE_UTIL_LINUX_SCHEDUTILS=y
BR2_PACKAGE_UTIL_LINUX_WIPEFS=y
BR2_PACKAGE_UTIL_LINUX_LOGIN=y
BR2_PACKAGE_UTIL_LINUX_SU=y
BR2_PACKAGE_E2FSPROGS=y
BR2_PACKAGE_E2FSPROGS_RESIZE2FS=y
BR2_PACKAGE_DOSFSTOOLS=y
BR2_PACKAGE_DOSFSTOOLS_FATLABEL=y
BR2_PACKAGE_DOSFSTOOLS_FSCK_FAT=y
BR2_PACKAGE_DOSFSTOOLS_MKFS_FAT=y
BR2_PACKAGE_CA_CERTIFICATES=y
BR2_PACKAGE_LIBCURL=y
BR2_PACKAGE_LIBCURL_CURL=y

# --- Ag -------------------------------------------------------------------------
BR2_PACKAGE_NETWORK_MANAGER=y
BR2_PACKAGE_NETWORK_MANAGER_CLI=y
BR2_PACKAGE_WPA_SUPPLICANT=y
BR2_PACKAGE_WPA_SUPPLICANT_NL80211=y
BR2_PACKAGE_WPA_SUPPLICANT_AP_SUPPORT=y
BR2_PACKAGE_WPA_SUPPLICANT_AUTOSCAN=y
BR2_PACKAGE_WPA_SUPPLICANT_EAP=y
BR2_PACKAGE_WPA_SUPPLICANT_WPA3=y
BR2_PACKAGE_WPA_SUPPLICANT_CLI=y
BR2_PACKAGE_WPA_SUPPLICANT_DBUS=y
BR2_PACKAGE_DNSMASQ=y
BR2_PACKAGE_NFTABLES=y
BR2_PACKAGE_IPROUTE2=y
BR2_PACKAGE_IW=y
BR2_PACKAGE_OPENSSH=y
BR2_PACKAGE_BLUEZ5_UTILS=y
BR2_PACKAGE_BLUEZ5_UTILS_CLIENT=y

# --- Grafik: Mesa (v3d + vc4), Wayland, labwc + cog (WPE) ------------------------------
BR2_PACKAGE_MESA3D=y
BR2_PACKAGE_MESA3D_GALLIUM_DRIVER_V3D=y
BR2_PACKAGE_MESA3D_GALLIUM_DRIVER_VC4=y
# Yazilim yedegi (GPU yok/bozuk, QEMU ve sanal testler): kabuk yine acilir.
BR2_PACKAGE_MESA3D_GALLIUM_DRIVER_SOFTPIPE=y
BR2_PACKAGE_MESA3D_GBM=y
BR2_PACKAGE_MESA3D_OPENGL_EGL=y
BR2_PACKAGE_MESA3D_OPENGL_ES=y
BR2_PACKAGE_WAYLAND=y
BR2_PACKAGE_WAYLAND_UTILS=y
BR2_PACKAGE_XKEYBOARD_CONFIG=y
BR2_PACKAGE_LIBINPUT=y
BR2_PACKAGE_LABWC=y
BR2_PACKAGE_WLR_RANDR=y
BR2_PACKAGE_JPEG=y
BR2_PACKAGE_JPEG_TURBO=y
BR2_PACKAGE_SEATD=y
BR2_PACKAGE_WPEWEBKIT=y
BR2_PACKAGE_COG=y
BR2_PACKAGE_COG_PROGRAMS_HOME_URI="http://127.0.0.1/"
BR2_PACKAGE_COG_PLATFORM_FDO=y
BR2_PACKAGE_DEJAVU=y

# --- Kamera / donanim -----------------------------------------------------------
BR2_PACKAGE_LIBCAMERA=y
BR2_PACKAGE_LIBCAMERA_PYTHON=y
BR2_PACKAGE_LIBCAMERA_PIPELINE_RPI_VC4=y
BR2_PACKAGE_LIBCAMERA_PIPELINE_UVCVIDEO=y
BR2_PACKAGE_LIBCAMERA_APPS=y
BR2_PACKAGE_LIBGPIOD2=y
BR2_PACKAGE_LIBGPIOD2_TOOLS=y
BR2_PACKAGE_I2C_TOOLS=y

# --- Gelistirici araclari -------------------------------------------------------
BR2_PACKAGE_PYTHON3=y
BR2_PACKAGE_PYTHON3_PYC_ONLY=y
BR2_PACKAGE_PYTHON3_BZIP2=y
BR2_PACKAGE_PYTHON3_CURSES=y
BR2_PACKAGE_PYTHON3_DECIMAL=y
BR2_PACKAGE_PYTHON3_PYEXPAT=y
BR2_PACKAGE_PYTHON3_READLINE=y
BR2_PACKAGE_PYTHON3_SSL=y
BR2_PACKAGE_PYTHON3_SQLITE=y
BR2_PACKAGE_PYTHON3_UNICODEDATA=y
BR2_PACKAGE_PYTHON3_XZ=y
BR2_PACKAGE_PYTHON3_ZLIB=y
BR2_PACKAGE_PYTHON_PIP=y
BR2_PACKAGE_GIT=y

# --- OTA: RAUC ------------------------------------------------------------------
BR2_PACKAGE_RAUC=y
BR2_PACKAGE_RAUC_DBUS=y
BR2_PACKAGE_RAUC_NETWORK=y
BR2_PACKAGE_RAUC_STREAMING=y
BR2_PACKAGE_RAUC_JSON=y
# Imzali guncelleme paketi (makeros-<surum>-rpi4.raucb) derleme makinesinde uretilir (post-image.sh).
BR2_PACKAGE_HOST_RAUC=y

# --- Kapsayicilar: podman (docker uyumlu CLI: /usr/bin/docker sarmalayici) ------
BR2_PACKAGE_PODMAN=y
BR2_PACKAGE_PODMAN_INIT_CATATONIT=y
BR2_PACKAGE_PODMAN_NET_PASST=y
BR2_PACKAGE_CRUN=y

# --- Dosya sistemleri / imaj ----------------------------------------------------
BR2_TARGET_ROOTFS_EROFS=y
BR2_TARGET_ROOTFS_EROFS_LZ4HC=y
BR2_TARGET_ROOTFS_EROFS_DEDUPE=y
BR2_TARGET_ROOTFS_EROFS_ZTAILPACKING=y
# BR2_TARGET_ROOTFS_TAR is not set
BR2_PACKAGE_HOST_DOSFSTOOLS=y
BR2_PACKAGE_HOST_E2FSPROGS=y
BR2_PACKAGE_HOST_GENIMAGE=y
BR2_PACKAGE_HOST_MTOOLS=y

# --- MakerOS paketleri (BR2_EXTERNAL) -------------------------------------------
BR2_PACKAGE_MAKERD=y
BR2_PACKAGE_MAKEROS_SHELL=y
BR2_PACKAGE_MAKEROS_FIRSTBOOT=y
BR2_PACKAGE_UV_BIN=y
BR2_PACKAGE_LLAMA_CPP=y
BR2_PACKAGE_MAKEROS_NODE=y
BR2_PACKAGE_FONT_INTER=y
BR2_PACKAGE_CHROMIUM_BIN=y
```

## os/package/aml/Config.in
```kconfig
config BR2_PACKAGE_AML
	bool "aml"
	depends on BR2_TOOLCHAIN_HAS_THREADS
	help
	  Andri's Main Loop: neatvnc ve wayvnc'nin olay dongusu.

	  https://github.com/any1/aml
```

## os/package/chromium-bin/Config.in
```kconfig
config BR2_PACKAGE_CHROMIUM_BIN
	bool "chromium-bin"
	depends on BR2_aarch64
	depends on BR2_TOOLCHAIN_USES_GLIBC
	help
	  Chromium web tarayıcı (Debian trixie arm64 derlemesi, kütüphaneleriyle
	  /opt/chromium altında). Paket os/chromium/build-bundle.sh ile Docker
	  içinde üretilir; glibc imajınkidir. Wayland (labwc) üzerinde çalışır.

	  https://www.chromium.org
```

## os/package/font-inter/Config.in
```kconfig
config BR2_PACKAGE_FONT_INTER
	bool "font-inter"
	select BR2_PACKAGE_FONTCONFIG
	help
	  Inter yazi tipi (rsms/inter, OFL-1.1): kabugun varsayilan yazi
	  tipi. Degisken TTF -> /usr/share/fonts/inter.

	  https://rsms.me/inter/
```

## os/package/labwc/Config.in
```kconfig
config BR2_PACKAGE_LABWC
	bool "labwc"
	depends on !BR2_STATIC_LIBS # wlroots
	depends on BR2_TOOLCHAIN_HAS_THREADS # wlroots
	depends on BR2_PACKAGE_HAS_LIBEGL # wlroots
	depends on BR2_PACKAGE_HAS_LIBGLES # wlroots
	depends on BR2_PACKAGE_HAS_LIBGBM # wlroots
	depends on BR2_PACKAGE_HAS_UDEV # wlroots
	depends on BR2_USE_WCHAR # glib2, pango
	depends on BR2_USE_MMU # glib2
	depends on BR2_INSTALL_LIBSTDCPP # pango
	depends on BR2_TOOLCHAIN_HAS_SYNC_4 # pango
	select BR2_PACKAGE_WLROOTS
	select BR2_PACKAGE_LIBXML2
	select BR2_PACKAGE_LIBGLIB2
	select BR2_PACKAGE_CAIRO
	select BR2_PACKAGE_CAIRO_PNG
	select BR2_PACKAGE_PANGO
	select BR2_PACKAGE_LIBPNG
	help
	  Hafif, wlroots tabanli pencere yoneticisi (Raspberry Pi OS'un
	  varsayilani). MakerOS'ta web kabuk (cog) tam ekran altta, yerel
	  uygulamalar (foot, GTK, OpenCV) ustte pencere olarak calisir.

	  https://labwc.github.io
```

## os/package/llama-cpp/Config.in
```kconfig
config BR2_PACKAGE_LLAMA_CPP
	bool "llama-cpp"
	depends on BR2_aarch64
	depends on BR2_INSTALL_LIBSTDCPP
	depends on BR2_TOOLCHAIN_HAS_THREADS
	help
	  llama.cpp: yerel LLM çıkarımı (llama-server, llama-cli).
	  makeros-ai (Türkçe Linux asistanı) llama-server'ı kullanır.
	  Pi 4 (Cortex-A72, NEON) için derlenir; OpenMP ve curl kapalı
	  (çalışma zamanında internet gerekmez).

	  https://github.com/ggml-org/llama.cpp

comment "llama-cpp C++ ve iş parçacığı destekli araç zinciri ister"
	depends on BR2_aarch64
	depends on !BR2_INSTALL_LIBSTDCPP || !BR2_TOOLCHAIN_HAS_THREADS
```

## os/package/makerd/Config.in
```kconfig
config BR2_PACKAGE_MAKERD
	bool "makerd"
	depends on BR2_PACKAGE_HOST_RUSTC_TARGET_ARCH_SUPPORTS
	depends on BR2_INIT_SYSTEMD
	select BR2_PACKAGE_HOST_RUSTC
	help
	  MakerOS arka uc hizmeti (Rust): makerd (yetkisiz, :80/:443),
	  makerd-priv (soket ile etkinlesen dar root yardimcisi) ve
	  makerd-user (kullanici basina terminal hizmeti).
	  Kaynak: depodaki ../makerd dizini (local site method).
```

## os/package/makeros-firstboot/Config.in
```kconfig
config BR2_PACKAGE_MAKEROS_FIRSTBOOT
	bool "makeros-firstboot"
	depends on BR2_INIT_SYSTEMD
	help
	  Ilk acilista bir kez calisan hazirlik: cihaza ozel ana makine adi
	  (makeros-XXXX), SSH host anahtarlari, /data dizinleri. Kullanici ve
	  parola kurulum sihirbazinda (makerd-priv) olusturulur.
```

## os/package/makeros-node/Config.in
```kconfig
config BR2_PACKAGE_MAKEROS_NODE
	bool "makeros-node"
	depends on BR2_aarch64
	depends on BR2_TOOLCHAIN_USES_GLIBC
	depends on !BR2_PACKAGE_NODEJS
	help
	  Resmi Node.js v24 LTS linux-arm64 ikilisi (nodejs.org), derleme
	  yerine (~45 dk tasarruf). /opt/node, /usr/bin/{node,npm,npx}.

	  https://nodejs.org/
```

## os/package/makeros-shell/Config.in
```kconfig
config BR2_PACKAGE_MAKEROS_SHELL
	bool "makeros-shell"
	help
	  MakerOS web masaustu kabugu (derleme adimsiz ES modulleri + Web
	  Components). Kaynak: depodaki ../shell -> /usr/share/makeros/shell.
	  .js/.css/.html/.svg/.json dosyalarinin gzip'li kopyalari da uretilir
	  (makerd on-sikistirilmis dosyayi sunar).
```

## os/package/neatvnc/Config.in
```kconfig
config BR2_PACKAGE_NEATVNC
	bool "neatvnc"
	depends on BR2_TOOLCHAIN_HAS_THREADS # aml
	select BR2_PACKAGE_AML
	select BR2_PACKAGE_PIXMAN
	select BR2_PACKAGE_ZLIB
	select BR2_PACKAGE_LIBDRM
	help
	  VNC sunucu kutuphanesi. jpeg-turbo varsa Tight/JPEG, ffmpeg +
	  GBM varsa Pi 4 donanim H.264 (V4L2 M2M) kodlamasi acilir.

	  https://github.com/any1/neatvnc
```

## os/package/uv-bin/Config.in
```kconfig
config BR2_PACKAGE_UV_BIN
	bool "uv-bin"
	depends on BR2_aarch64
	depends on BR2_TOOLCHAIN_USES_GLIBC
	help
	  Astral uv (onceden derlenmis aarch64 glibc ikilisi): Python surum
	  ve sanal ortam yoneticisi. /usr/bin/uv, /usr/bin/uvx.

	  https://github.com/astral-sh/uv
```

## os/package/wayvnc/Config.in
```kconfig
config BR2_PACKAGE_WAYVNC
	bool "wayvnc"
	depends on BR2_TOOLCHAIN_HAS_THREADS
	depends on !BR2_STATIC_LIBS # wayland
	select BR2_PACKAGE_NEATVNC
	select BR2_PACKAGE_AML
	select BR2_PACKAGE_JANSSON
	select BR2_PACKAGE_LIBXKBCOMMON
	select BR2_PACKAGE_PIXMAN
	select BR2_PACKAGE_WAYLAND
	select BR2_PACKAGE_LIBDRM
	help
	  wlroots tabanli compositor'lar (labwc, cage) icin VNC sunucusu.
	  Yerlesik WebSocket dinleyicisi sayesinde noVNC dogrudan baglanir.

	  https://github.com/any1/wayvnc
```
